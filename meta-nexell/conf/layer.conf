## meta-nexell/conf/layer.conf
```bitbake
# We have a conf and classes directory, add to BBPATH
BBPATH .= ":${LAYERDIR}"

# We have recipes-* directories, add to BBFILES
BBFILES += "${LAYERDIR}/recipes-*/*/*.bb ${LAYERDIR}/recipes-*/*/*.bbappend"

BBFILE_COLLECTIONS += "nexell"
BBFILE_PATTERN_nexell = "^${LAYERDIR}/"
BBFILE_PRIORITY_nexell = "20"

# This should only be incremented on significant changes that will
# cause compatibility issues with other layers
LAYERVERSION_nexell = "1"

LAYERDEPENDS_nexell = "linaro-toolchain"
```

## meta-nexell/conf/machine/include/nexell.inc
```bitbake
PREFERRED_PROVIDER_virtual/xserver ?= "xserver-xorg"
PREFERRED_PROVIDER_virtual/egl ?= "mesa"
PREFERRED_PROVIDER_virtual/libgl ?= "mesa"
PREFERRED_PROVIDER_virtual/libgles1 ?= "mesa"
PREFERRED_PROVIDER_virtual/libgles2 ?= "mesa"

XSERVER ?= "xserver-xorg \
            ${@bb.utils.contains('DISTRO_FEATURES', 'opengl', 'mesa-driver-swrast', '', d)} \
            xf86-input-evdev \
            xf86-input-mouse \
            xf86-video-fbdev \
            xf86-input-keyboard"

MACHINE_FEATURES = "alsa bluetooth usbgadget screen"

IMAGE_FSTYPES += "tar.bz2 ext4"
```

## meta-nexell/conf/machine/nexellarmv8.conf
```bitbake
#@TYPE: Machine
#@NAME: generic armv8 machine
#@DESCRIPTION: Machine configuration for running a generic armv8

require conf/machine/include/arm/arch-armv8.inc
require conf/machine/include/nexell.inc

MACHINE_FEATURES = ""
```
